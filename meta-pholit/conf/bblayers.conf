## meta-pholit/conf/bblayers.conf
```bitbake
# This template file was created by taking the oe-core/meta/conf/bblayers.conf
# file and removing the BBLAYERS section at the end.

# LAYER_CONF_VERSION is increased each time build/conf/bblayers.conf
# changes incompatibly
LCONF_VERSION = "7"

BBPATH = "${TOPDIR}"
BBFILES ?= ""

# Layers configured by oe-core-setup script
BBLAYERS += " \
  /home/build/tisdk/sources/meta-tisdk \
  /home/build/tisdk/sources/meta-arago/meta-arago-distro \
  /home/build/tisdk/sources/meta-arago/meta-arago-extras \
  /home/build/tisdk/sources/meta-arago/meta-arago-demos \
  /home/build/tisdk/sources/meta-arago/meta-arago-test \
  /home/build/tisdk/sources/meta-qt5 \
  /home/build/tisdk/sources/meta-virtualization \
  /home/build/tisdk/sources/meta-openembedded/meta-networking \
  /home/build/tisdk/sources/meta-openembedded/meta-python \
  /home/build/tisdk/sources/meta-openembedded/meta-oe \
  /home/build/tisdk/sources/meta-openembedded/meta-gnome \
  /home/build/tisdk/sources/meta-openembedded/meta-filesystems \
  /home/build/tisdk/sources/meta-openembedded/meta-multimedia \
  /home/build/tisdk/sources/meta-ti/meta-ti-extras \
  /home/build/tisdk/sources/meta-ti/meta-ti-bsp \
  /home/build/tisdk/sources/meta-arm/meta-arm \
  /home/build/tisdk/sources/meta-arm/meta-arm-toolchain \
  /home/build/tisdk/sources/oe-core/meta \
  /home/build/meta-pholit \
  "
```

## meta-pholit/conf/layer.conf
```bitbake
# We have a conf and classes directory, add to BBPATH
BBPATH .= ":${LAYERDIR}"

# We have recipes-* directories, add to BBFILES
BBFILES += "${LAYERDIR}/recipes-*/*/*.bb \
            ${LAYERDIR}/recipes-*/*/*.bbappend"

BBFILE_COLLECTIONS += "meta-pholit"
BBFILE_PATTERN_meta-pholit = "^${LAYERDIR}/"
BBFILE_PRIORITY_meta-pholit = "6"

LAYERDEPENDS_meta-pholit = "core"
LAYERSERIES_COMPAT_meta-pholit = " kirkstone"

DISTRO_FEATURES:append = " systemd"
DISTRO_FEATURES_BACKFILL_CONSIDERED += "sysvinit"
VIRTUAL-RUNTIME_init_manager = "systemd"
VIRTUAL-RUNTIME_initscripts = "systemd-compat-units"

DISTRO_FEATURES:append = " usrmerge"
```
